## examples/filesystem/app/boards/native_sim.conf
```kconfig
CONFIG_FILE_SYSTEM_SHELL_MOUNT_COMMAND=y
# CONFIG_FILE_SYSTEM_SHELL_TEST_COMMANDS is not set
CONFIG_FILE_SYSTEM_SHELL_LS_SIZE=y
# CONFIG_FILE_SYSTEM_MKFS is not set
# CONFIG_FILE_SYSTEM_GC is not set
#CONFIG_FUSE_FS_ACCESS=y
#CONFIG_FUSE_LIBRARY_V2=y
#CONFIG_FUSE_LIBRARY_V3=n
```
